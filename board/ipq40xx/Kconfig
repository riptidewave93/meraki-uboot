## board/ipq40xx/Kconfig
```kconfig
menu "QCOM IPQ40XX platforms"
	depends on ARCH_IPQ40xx

config SYS_VENDOR
	default "qca/arm"

config SYS_BOARD
	default "ipq40xx"

config SYS_CONFIG_NAME
	default "ipq40xx_cdp"

config EEPROM_I2C_ADDR
	hex "EEPROM's I2C Addr"
	help
	  This is the address of the EEPROM on the I2C bus.

config CPU_CONTEXT_DUMP_BASE
	hex
	default 0x87B00000

config CPU_CONTEXT_DUMP_SIZE
	hex
	default 0x80000

config QPIC_NAND_NAND_INFO_IDX
	int
	default 0

config SYS_TEXT_BASE
	hex "Text Base"
	default 0x87300000

source "board/qca/arm/Kconfig"

endmenu
```

## board/ipq806x/Kconfig
```kconfig
menu "QCOM IPQ806X platforms"
	depends on ARCH_IPQ806x

config SYS_VENDOR
	default "qca/arm"

config SYS_BOARD
	default "ipq806x"

config SYS_CONFIG_NAME
	default "ipq806x_cdp"

config SYS_TEXT_BASE
	hex "Text Base"
	default 0x41200000

config IPQ_APPSBL_DLOAD
	bool
	default y

config MBN_HEADER
	bool "Add MBN header to U-Boot"
	default y

config IPQ_APPSBL_IMG_TYPE
	hex
	default 0x5

config EEPROM_I2C_ADDR
	hex "EEPROM's I2C Addr"
	help
	  This is the address of the EEPROM on the I2C bus.

config ENV_SIZE_MAX
	hex
	default 0x40000

config IPQ_SPI_NAND_INFO_IDX
	int
	default 1

config IPQ_NAND_NAND_INFO_IDX
	int
	default 0

config IPQ_FIRMWARE
	bool "Support NSS firmware loading using bootm"
	default n

source "board/qca/arm/Kconfig"

endmenu
```

## board/qca/arm/Kconfig
```kconfig
config IPQ_SWITCH_ATHRS17
	bool "Atheros S17"
	depends on NETDEVICES
	default n
	help
	  This supports Atheros S17.

config IPQ_SWITCH_QCA8511
	bool "8511 Switch"
	default n
	depends on NETDEVICES
	help
	  This supports 8511 Switch chip.

config IPQ_MAX_SPI_DEVICE
	int
	default 2 if ARCH_IPQ40xx
	default 1 if ARCH_IPQ806x

config QCA_SMEM_BASE
	hex
	default 0x87e00000 if ARCH_IPQ40xx
	default 0x41000000 if ARCH_IPQ806x

config ENV_SIZE_MAX
	hex "Maximum Environment size"
	default 0x40000

config IPQ_APPSBL_DLOAD
	bool
	default y

config IPQ_MAX_NAND_DEVICE
	int
	default 1
```

## drivers/net/ipq40xx/Kconfig
```kconfig
menu "QCOM IPQ40XX platforms"
	depends on ARCH_IPQ40xx && NETDEVICES

config IPQ40XX_EDMA
	bool "IPQ40XX EDMA Driver"
	default y

config IPQ40XX_ESS
	bool "IPQ40XX ESS Driver"
	default y

config QCA8075_PHY
	bool "QCA8075 Phy"
	default y

config QCA8033_PHY
	bool "QCA8033 Phy"
	bool
	default y

config IPQ40XX_MDIO
	bool "IPQ40XX MDIO Driver"
	bool
	default y

config IPQ_NO_MACS
	int
	default 2

endmenu
```

## drivers/net/ipq806x/Kconfig
```kconfig
menu "QCOM IPQ806X platforms"
	depends on ARCH_IPQ806x && NETDEVICES

config IPQ_SNPS_GMAC
	bool "IPQ GMAC"

config IPQ_MDIO
	bool "IPQ806X MDIO Driver"
	depends on IPQ_SNPS_GMAC
	default y

endmenu
```
